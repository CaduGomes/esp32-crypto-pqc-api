## sdkconfig.defaults
```kconfig
# Configurações padrão para o projeto
# Essas configurações serão aplicadas automaticamente ao executar idf.py set-target

# Habilitar SHA3 no MbedTLS
CONFIG_MBEDTLS_SHA3_C=y

# Aumentar o timeout do Task Watchdog para 60 segundos (necessário para SLH-DSA)
CONFIG_ESP_TASK_WDT_TIMEOUT_S=60

# Aumentar a pilha da tarefa principal para 100KB (Necessário para ML-DSA/Dilithium que usa muita pilha)
CONFIG_ESP_MAIN_TASK_STACK_SIZE=102400

# Aumentar a pilha do ISR do sistema para evitar estouro em operações criptográficas intensas
CONFIG_ESP_SYSTEM_EVENT_TASK_STACK_SIZE=4096

# Enable comprehensive heap poisoning to catch buffer overflows immediately
CONFIG_HEAP_POISONING_COMPREHENSIVE=y

# Custom Partition Table
CONFIG_PARTITION_TABLE_CUSTOM=y
CONFIG_PARTITION_TABLE_CUSTOM_FILENAME="partitions.csv"
CONFIG_PARTITION_TABLE_FILENAME="partitions.csv"
```
